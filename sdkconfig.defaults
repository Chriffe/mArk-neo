## sdkconfig.defaults
```kconfig
# Common defaults
CONFIG_HTTPD_MAX_REQ_HDR_LEN=4096
CONFIG_ESP_WIFI_SOFTAP_SUPPORT=n

# TLS — enable Mozilla root CA bundle for HTTPS
CONFIG_MBEDTLS_CERTIFICATE_BUNDLE=y
CONFIG_MBEDTLS_CERTIFICATE_BUNDLE_DEFAULT_FULL=y
```
